## board/samsung/smdk2440/Kconfig
```kconfig
if TARGET_SMDK2440

config SYS_BOARD
	default "smdk2440"

config SYS_VENDOR
	default "samsung"

config SYS_SOC
	default "s3c24x0"

config SYS_CONFIG_NAME
	default "smdk2440"

endif
```

## configs/smdk2440_defconfig
```kconfig
CONFIG_ARM=y
CONFIG_TARGET_SMDK2440=y
CONFIG_SYS_PROMPT="\nGMF@2440 # "
CONFIG_CMD_USB=y
CONFIG_CMD_DHCP=y
CONFIG_CMD_PING=y
CONFIG_CMD_CACHE=y
CONFIG_CMD_EXT2=y
CONFIG_CMD_FAT=y

CONFIG_CMD_MEMTEST=y
CONFIG_LOCALVERSION=" - Modified by Mingfei Gao  "
CONFIG_LOCALVERSION_AUTO=n
CONFIG_HUSH_PARSER=y
```
